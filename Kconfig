## Kconfig
```kconfig
menu "Double reset"
    config DOUBLE_RESET_DEFAULT_TIMEOUT
        int "Default double reset detection timeout"
        default 5000
        help
            Timeout, in milliseconds.
endmenu
```

## example/Kconfig.projbuild
```kconfig
menu "Double reset"
    config DOUBLE_RESET_DEFAULT_TIMEOUT
        int "Default double reset detecion timeout"
        default 3000
        help
            Timeout, in milliseconds.
endmenu
```

## example/main/Kconfig.projbuild
```kconfig
menu "Application config"
    config STATUS_LED_GPIO
        int "Status LED GPIO"
        default 22
        help
            GPIO PIN status LED is connected to.

    config STATUS_LED_ON
        int "Status LED ON logic level"
        default 0
        help
            GPIO logic leven, when status LED is powerd on - 1 when HIGH corresponds to an ON state, 0 when LOW corresponds to an ON state.
endmenu
```
